#include "motionSensor.hpp"

// Store the pin number
static int motionRightPin = -1;
static int motionLeftPin = -1;

/*/////////////////////////////////////////////////////////////////////////////////////////////////////////
// --- Initialize the sensor pin ---
/////////////////////////////////////////////////////////////////////////////////////////////////////////*/
void initMotionRightSensor(int pin)
{
    motionRightPin = pin;
    pinMode(motionRightPin, INPUT);
}

/*/////////////////////////////////////////////////////////////////////////////////////////////////////////
// --- Initialize the sensor pin ---
/////////////////////////////////////////////////////////////////////////////////////////////////////////*/
void initMotionLeftSensor(int pin)
{
    motionLeftPin = pin;
    pinMode(motionLeftPin, INPUT);
}

/*/////////////////////////////////////////////////////////////////////////////////////////////////////////
// --- Check for right motion ---
/////////////////////////////////////////////////////////////////////////////////////////////////////////*/
bool isMotionRightDetected()
{
    if (motionRightPin == MOTION_PIN_RIGHT) return digitalRead(motionRightPin) == HIGH;
    
    return false;
}

/*/////////////////////////////////////////////////////////////////////////////////////////////////////////
// --- Check for left motion ---
/////////////////////////////////////////////////////////////////////////////////////////////////////////*/
bool isMotionLeftDetected()
{
    if (motionLeftPin == MOTION_PIN_LEFT) return digitalRead(motionLeftPin) == HIGH;
    
    return false;
}

/*/////////////////////////////////////////////////////////////////////////////////////////////////////////
// --- Check for Both Direction motion ---
/////////////////////////////////////////////////////////////////////////////////////////////////////////*/
bool isMotionBothDirDetected()
{
    if (motionRightPin == MOTION_PIN_RIGHT && motionLeftPin == MOTION_PIN_LEFT)
        return ( (digitalRead(motionRightPin) == HIGH) && (digitalRead(motionLeftPin) == HIGH) );
    
    return false;
}
